## examples/Kconfig
```kconfig
#
# Copyright 2026 Junbo Zheng
# SPDX-License-Identifier: Apache-2.0
#
# Kconfig for example application.
#

config CLI_BUILD_EXAMPLES
    bool "Build example application"
    default y
    help
      Build the demo CLI application in examples/.
      Use "Example Commands" menu to select which commands to include.

if CLI_BUILD_EXAMPLES

menu "Example Commands"

config CLI_CMD_LS
    bool "Enable 'ls' command"
    default y

config CLI_CMD_UPTIME
    bool "Enable 'uptime' command"
    default y

config CLI_CMD_DATE
    bool "Enable 'date' command"
    default y

config CLI_CMD_UNAME
    bool "Enable 'uname' command"
    default y

config CLI_CMD_PS
    bool "Enable 'ps' command"
    default y

config CLI_CMD_FREE
    bool "Enable 'free' command"
    default y

endmenu

endif
```

## src/Kconfig
```kconfig
#
# Copyright 2026 Junbo Zheng
# SPDX-License-Identifier: Apache-2.0
#
# Kconfig for CLI core library.
#

menu "CLI Core"

config CLI_VERSION
    string "Version string"
    default "2026.04.17"

config CLI_PROMPT
    string "Default prompt string"
    default "cli> "

config CLI_MAX_LINE
    int "Maximum input line length"
    default 256
    range 64 1024

config CLI_MAX_HISTORY
    int "History buffer depth"
    default 16
    range 4 128

config CLI_MAX_PROMPT
    int "Maximum prompt string length"
    default 32
    range 8 128

config CLI_MAX_COMMANDS
    int "Maximum registered commands"
    default 32
    range 8 128

config CLI_MAX_SUB_COMMANDS
    int "Maximum sub-commands per command"
    default 16
    range 4 64

choice CLI_CTRL_C_ACTION
    prompt "Ctrl-C behavior"
    default CLI_CTRL_C_QUIT

config CLI_CTRL_C_QUIT
    bool "Quit CLI"

config CLI_CTRL_C_CLEAR_LINE
    bool "Clear current line"

config CLI_CTRL_C_IGNORE
    bool "Ignore"

endchoice

endmenu

menu "Built-in Commands"

config CLI_CMD_HELP
    bool "Enable 'help' command"
    default y

config CLI_CMD_VERSION
    bool "Enable 'version' command"
    default y

config CLI_CMD_ECHO
    bool "Enable 'echo' command"
    default y

config CLI_CMD_CLEAR
    bool "Enable 'clear' command"
    default y

endmenu

menu "Platform"

choice CLI_PLATFORM
    prompt "Port layer"
    default CLI_PLATFORM_LINUX

config CLI_PLATFORM_LINUX
    bool "Linux/macOS (termios)"

config CLI_PLATFORM_RTOS
    bool "RTOS (user-provided UART)"

endchoice

endmenu

menu "CLI Networking"

config CLI_NET_ENABLE
    bool "Enable client/server mode"
    default n
    help
      Enable remote CLI access via transport layer (Unix socket or POSIX mq).
      Server embeds into the main process; clients connect remotely.

if CLI_NET_ENABLE

choice CLI_NET_TRANSPORT
    prompt "Transport layer"
    default CLI_NET_TRANSPORT_UNIX

config CLI_NET_TRANSPORT_UNIX
    bool "Unix domain socket"

config CLI_NET_TRANSPORT_MQ
    bool "POSIX message queue"

endchoice

config CLI_NET_SERVER
    bool "Build server library"
    default y

config CLI_NET_CLIENT
    bool "Build client application"
    default y

config CLI_NET_MAX_CLIENTS
    int "Maximum concurrent clients"
    default 4
    range 1 16

config CLI_NET_SOCKET_PATH
    string "Socket/endpoint path"
    default "/tmp/cli.sock"

endif # CLI_NET_ENABLE

endmenu

menu "Debug"

config CLI_ASAN
    bool "Enable AddressSanitizer (ASan)"
    default y if CLI_PLATFORM_LINUX
    help
      Detect memory errors: buffer overflow, use-after-free, etc.

config CLI_UBSAN
    bool "Enable UndefinedBehaviorSanitizer (UBSan)"
    default y if CLI_PLATFORM_LINUX
    help
      Detect undefined behavior: signed overflow, null deref, etc.

endmenu
```
